/dts-v1/;
/plugin/;

#include <dt-bindings/interrupt-controller/arm-gic.h>
#include "khaje.dtsi"

/ {
    model = "SPES Simple Framebuffer";
    compatible = "qcom,khaje";
    qcom,msm-id = <518 0x10000>;
    qcom,board-id = <0x20022 0>;
    qcom,pmic-id = <0x2D 0x0 0x0 0x0>;
};

&soc {
    simple-framebuffer {
        compatible = "simple-framebuffer";
        memory-region = <&cont_splash_memory>;
        width = <1080>;
        height = <2400>;
        stride = <(1080 * 4)>;
        format = "r8g8b8a8";
    };
};
