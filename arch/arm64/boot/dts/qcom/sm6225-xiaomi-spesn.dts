/*
/dts-v1/;
/plugin/;
*/

#include "sm6225-xiaomi-spesn.dtsi"

/ {
	model = "Redmi Note 11 NFC (SPESN KHAJE IDP nopmi)";
	compatible = "qcom,khaje-idp", "qcom,khaje", "qcom,idp";
	qcom,msm-id = <518 0x10000>;
	qcom,board-id = <0x30022 0>;
	qcom,pmic-id = <0x2D 0x0 0x0 0x0>;
};
